## testProjects/nuttxTest/Kconfig
```kconfig
# For a description of the syntax of this configuration file,
# see the file kconfig-language.txt in the NuttX tools repository.
#

config CUSTOM_APPS_MY_APP
	tristate "My App"
	default n
	---help---
		Enable My App

if CUSTOM_APPS_MY_APP

config CUSTOM_APPS_MY_APP_PROGNAME
	string "Program name"
	default "myapp"
	---help---
		This is the name of the program that will be used when the NSH ELF
		program is installed.

config CUSTOM_APPS_MY_APP_PRIORITY
	int "My App task priority"
	default 100

config CUSTOM_APPS_MY_APP_STACKSIZE
	int "My App stack size"
	default DEFAULT_TASK_STACKSIZE

endif 
```
